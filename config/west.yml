## config/west.yml
```yaml
manifest:
  remotes:
    - name: zmkfirmware
      url-base: https://github.com/zmkfirmware
    - name: cube219
      url-base: https://github.com/cube219
  projects:
    - name: zmk
      remote: zmkfirmware
      revision: v0.3
      import: app/west.yml
    - name: zmk-dongle-screen
      remote: cube219
      revision: main
  self:
    path: config
```
